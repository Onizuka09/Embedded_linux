## project/yocto-buildir/conf/bblayers.conf
```bitbake
# Version of layers configuration, specific to
# each defined distro in the repository.

BBPATH = "${TOPDIR}"
BBFILES ?= ""
HOST_USER = "${@os.getenv('USER') or 'ORIN'}"
BBLAYERS_DIR:="${TOPDIR}/.."
BBLAYERS ?= " \
  ${BBLAYERS_DIR}/yocto-layers/poky/meta \
  ${BBLAYERS_DIR}/yocto-layers/meta-openembedded/meta-oe \
  ${BBLAYERS_DIR}/yocto-layers/meta-openembedded/meta-python \
  ${BBLAYERS_DIR}/yocto-layers/meta-openembedded/meta-networking \
  ${BBLAYERS_DIR}/yocto-layers/meta-openembedded/meta-multimedia \
  ${BBLAYERS_DIR}/yocto-layers/meta-openembedded/meta-filesystems \
  ${BBLAYERS_DIR}/yocto-layers/meta-virtualization \
  ${BBLAYERS_DIR}/yocto-layers/meta-raspberrypi \
  ${BBLAYERS_DIR}/yocto-layers/meta-gooeygui \
  "
```
